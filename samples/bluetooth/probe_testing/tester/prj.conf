## CMakeLists.txt
```
#
# Copyright (c) 2020 Nordic Semiconductor ASA
#
# SPDX-License-Identifier: LicenseRef-Nordic-5-Clause
#
cmake_minimum_required(VERSION 3.20.0)

find_package(Zephyr REQUIRED HINTS $ENV{ZEPHYR_BASE})
project(probe_tester)

# NORDIC SDK APP START
target_sources(app PRIVATE
  src/main.c
  ../common/test_common.c
  ../common/test_connection.c
  ../common/test_gatt_server.c
)
target_include_directories(app PRIVATE ../common/)
# NORDIC SDK APP END
```

## prj.conf
```kconfig
CONFIG_BT=y
CONFIG_BT_DEBUG_LOG=y
CONFIG_BT_CENTRAL=y
CONFIG_BT_MAX_CONN=12
CONFIG_BT_MAX_PAIRED=12
CONFIG_BT_SMP=y
CONFIG_BT_PRIVACY=y
CONFIG_BT_GATT_CLIENT=y

CONFIG_BT_CTLR_DATA_LENGTH_MAX=251
CONFIG_BT_BUF_ACL_RX_SIZE=251
CONFIG_BT_BUF_ACL_TX_SIZE=251

CONFIG_BT_L2CAP_TX_MTU=247

# variations of this =n or =y on central/per produce different errors
CONFIG_BT_AUTO_PHY_UPDATE=y
CONFIG_BT_AUTO_DATA_LEN_UPDATE=y

CONFIG_ASSERT=y
CONFIG_ASSERT_LEVEL=2
CONFIG_ASSERT_VERBOSE=y
CONFIG_ASSERT_ON_ERRORS=y

# TODO: use default 3
# we get an ATT timeout if 3
# we get an SMP timeout if 10
# CONFIG_BT_L2CAP_TX_BUF_COUNT=10

# deadlock on central with the default.
# the problem is that `tx_free` is called from both syswq and btwq in that case.
CONFIG_BT_RECV_WORKQ_BT=y
# CONFIG_BT_RECV_WORKQ_SYS=y

# TODO: remove when test is stable
CONFIG_BT_AUTO_PHY_UPDATE=n
CONFIG_BT_AUTO_DATA_LEN_UPDATE=n
CONFIG_BT_GAP_AUTO_UPDATE_CONN_PARAMS=n

CONFIG_THREAD_NAME=y

CONFIG_BT_HCI_CORE_LOG_LEVEL_WRN=y
```

## src/main.c
```c
/*
 * Copyright (c) 2023 Nordic Semiconductor ASA
 *
 * SPDX-License-Identifier: Apache-2.0
 */

#include "test_common.h"

void test_init(void)
{
	test_connection_init();
	test_gatt_server_init();
}

void test_loop(void)
{
	test_gatt_server_wait_for(BT_GATT_CCC_NOTIFY);
	test_gatt_server_notify_all();
	test_gatt_server_wait_for(0);

	test_gatt_server_wait_for(BT_GATT_CCC_INDICATE);
	test_gatt_server_indicate_all();
	test_gatt_server_wait_for(0);
}

void test_main(void)
{
	test_init();

	test_central_connect();

	for (int i = 0; i < TEST_LOOP; i++) {
		test_loop();
	}

	test_disconnect_all();

	END_TEST("TESTER")
	BSIM_BUSY_WAIT
}

int main(void)
{
	test_main();
	return 0;
}
```
