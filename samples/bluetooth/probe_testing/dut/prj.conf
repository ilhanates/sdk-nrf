## CMakeLists.txt
```
#
# Copyright (c) 2020 Nordic Semiconductor ASA
#
# SPDX-License-Identifier: LicenseRef-Nordic-5-Clause
#
cmake_minimum_required(VERSION 3.20.0)

find_package(Zephyr REQUIRED HINTS $ENV{ZEPHYR_BASE})
project(probe_dut)

# NORDIC SDK APP START
target_sources(app PRIVATE
  src/main.c
  ../common/test_common.c
  ../common/test_connection.c
  ../common/test_gatt_client.c
)
target_include_directories(app PRIVATE ../common/)
```

## prj.conf
```kconfig
# Increased stack due to settings API usage
CONFIG_SYSTEM_WORKQUEUE_STACK_SIZE=2048

CONFIG_BT=y
CONFIG_BT_DEBUG_LOG=y
CONFIG_BT_SMP=y
CONFIG_BT_PRIVACY=y
CONFIG_BT_PERIPHERAL=y
CONFIG_BT_GATT_CLIENT=y
CONFIG_BT_ATT_PREPARE_COUNT=5
CONFIG_BT_MAX_CONN=1
CONFIG_BT_MAX_PAIRED=1
CONFIG_BT_ID_MAX=1
CONFIG_BT_DEVICE_NAME="per-default"
CONFIG_BT_DEVICE_NAME_DYNAMIC=y
CONFIG_BT_DEVICE_APPEARANCE=833
CONFIG_BT_DEVICE_NAME_DYNAMIC=y
CONFIG_BT_DEVICE_NAME_MAX=65

CONFIG_BT_CTLR_DATA_LENGTH_MAX=251
CONFIG_BT_BUF_ACL_RX_SIZE=251
CONFIG_BT_BUF_ACL_TX_SIZE=251

CONFIG_BT_L2CAP_TX_MTU=247

CONFIG_ASSERT=y
CONFIG_ASSERT_LEVEL=2
CONFIG_ASSERT_VERBOSE=y
CONFIG_ASSERT_ON_ERRORS=y

CONFIG_BT_LOG_SNIFFER_INFO=y

# TODO: remove when test is stable
CONFIG_BT_AUTO_PHY_UPDATE=n
CONFIG_BT_AUTO_DATA_LEN_UPDATE=n
CONFIG_BT_GAP_AUTO_UPDATE_CONN_PARAMS=n

CONFIG_THREAD_NAME=y

CONFIG_BT_HCI_CORE_LOG_LEVEL_WRN=y
```

## src/main.c
```c
/*
 * Copyright (c) 2023 Nordic Semiconductor ASA
 *
 * SPDX-License-Identifier: Apache-2.0
 */

#include "test_common.h"

conn_info_t *conn_info = NULL;

void test_init(void)
{
	test_connection_init();
	test_gatt_client_init();
}

void test_loop(void)
{
	test_gatt_client_subscribe(conn_info, BT_GATT_CCC_NOTIFY);
	test_gatt_client_wait_for(conn_info, CONN_INFO_NOTIFIED);
	test_gatt_client_unsubscribe(conn_info);

	test_gatt_client_subscribe(conn_info, BT_GATT_CCC_INDICATE);
	test_gatt_client_wait_for(conn_info, CONN_INFO_INDICATED);
	test_gatt_client_unsubscribe(conn_info);

	test_gatt_client_write_without_resp(conn_info);
}

void test_main(void)
{
	int ret = 0;

	test_init();

	conn_info = test_peripheral_connect();
	if(!conn_info) return;

	ret = test_gatt_client_discover(conn_info);
	if (ret) return;

	for (int i = 0; i < TEST_LOOP; i++) {
		test_loop();
	}

	test_connection_wait_for(conn_info->conn, CONN_INFO_DISCONNECTED);

	END_TEST("DUT")
	BSIM_BUSY_WAIT
}

int main(void)
{
	test_main();

	return 0;
}
```
